## app/boards/sf32lb52-xty-ai-tht/lcpu/Kconfig.board
```kconfig
config BSP_USING_BOARD_SF32LB52_XTY_AI_THT
    bool
    select SOC_SF32LB52X
    select BF0_LCPU
    default y

rsource "../Kconfig.board"
```

## app/project/Kconfig.proj
```kconfig
#APP specific configuration.
config BF0_HCPU
    bool
    default y

config CUSTOM_MEM_MAP
    bool 
	select custom_mem_map
	default y    

config XIAOZHI_USING_MQTT
    bool "xiaozhi_using_mqtt"
	default n

config CONFIG_IOT_PROTOCOL_MCP
    bool "using mcp protocol"
	default y 

config RT_USING_SPI_MSD
	default y

config MSD_SPI_TF_INSERT_DETE_PIN
	default 33

config DFS_FILESYSTEMS_MAX
	default 4

comment "------------Project configuration-----------"



config BLUETOOTH_NAME
    string "Bluetooth device name"
    default "ink"
    help
        Specify the Bluetooth device name for the application.

config BT_NAME_MAC_ENABLE
    bool "Append the MAC address to the Bluetooth name"
    default n
    help
        Append the MAC address to the Bluetooth name, such as "ink-12:34:56:78:9a:bc".

# KWS
config KWS_ENABLE_DEFAULT
    bool "Enable KWS by default"
    default n
    help
        Enable KWS (Keyword Spotting) by default in the application. 
```

## sdk/customer/boards/sf32lb52-lcd_base/Kconfig.board
```kconfig
config ASIC
    bool 
    default y 
   
config TOUCH_IRQ_PIN
    int
    default 42 if BSP_USING_BOARD_SF32LB52_LCD_N16R8
    default 31

config LCD_PWM_BACKLIGHT_INTERFACE_NAME
    string
    default "pwm2"

config LCD_PWM_BACKLIGHT_CHANEL_NUM
    int
    default 4

config LCD_BACKLIGHT_CONTROL_PIN
    int
    default 1
    
config RGBLED_CONTROL_PIN
    int
    default 32  
```

## sdk/customer/boards/sf32lb52-lcd_n16r8/Kconfig.board
```kconfig
source "$SIFLI_SDK/customer/boards/sf32lb52-lcd_base/Kconfig.board"

config TOUCH_IRQ_PIN
    int
    default 42 if BSP_USING_BOARD_SF32LB52_LCD_N16R8
```

## sdk/customer/peripherals/wifi/Kconfig
```kconfig
menuconfig BSP_WIFI_SWT6621
    bool "Enable swt 6621 wifi mode"
    default n
    if BSP_WIFI_SWT6621
        config WIFI_WAKEUP_OUT_PIN
            int "SWT6621 WAKEUP OUT pin number"
            default 2
        config WIFI_WAKEUP_IN_PIN
            int "SWT6621 WAKEUP IN pin number" 
            default 5
        config WIFI_POWER_PIN
            int "SWT6621 POWER pin number"
            default 53
    endif
```

## sdk/example/pm/gui_pm/project/Kconfig.proj
```kconfig
#APP specific configuration.
config CUSTOM_MEM_MAP
    bool 
	select custom_mem_map
	default y    

config USING_RAISE_WRIST
	bool "USING_RAISE_WRIST"
	default y
```

## sdk/external/jpeg_codec/Kconfig
```kconfig
config USING_JPEG_ENC
    bool "Enable JPEG Accelerator Encoder"
    default n
config USING_JPEG_DEC
    bool "Enable Jpeg Accelerator Decoder"
    default n
```

## sdk/external/wpa_supplicant-rtos/Kconfig
```kconfig
config PKG_USING_WPA_SUPPLICANT
    bool "Enable WPA Supplicant"
    default n
    if PKG_USING_WPA_SUPPLICANT
        config PKG_USING_WPA_NET_NAME
            string "wpa net device name"
            default "m0"
        config PKG_USING_OS_FREERTOS
            bool "Enable seamless adaptation to Freertos system"
    default y
    endif
```
